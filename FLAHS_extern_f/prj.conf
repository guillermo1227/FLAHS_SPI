## sysbuild.conf
```
# MCUboot
SB_CONFIG_BOOTLOADER_MCUBOOT=y

# Step 3.1 - MCUboot should use external flash
SB_CONFIG_PM_EXTERNAL_FLASH_MCUBOOT_SECONDARY=y
# Step 3.1 - For SPI, we need to set  this
SB_CONFIG_PM_OVERRIDE_EXTERNAL_DRIVER_CHECK=y
```

## prj.conf
```kconfig
CONFIG_GPIO=y

# Enable mcumgr DFU in application
CONFIG_MCUMGR=y

# Enable MCUMGR management for both OS and Images
CONFIG_MCUMGR_GRP_OS=y
CONFIG_MCUMGR_GRP_IMG=y

# Configure MCUMGR transport to UART
CONFIG_MCUMGR_TRANSPORT_UART=y

# Dependencies
# Configure dependencies for CONFIG_MCUMGR  
CONFIG_NET_BUF=y
CONFIG_ZCBOR=y
CONFIG_CRC=y

# Configure dependencies for CONFIG_MCUMGR_GRP_IMG  
CONFIG_FLASH=y
CONFIG_IMG_MANAGER=y

# Configure dependencies for CONFIG_IMG_MANAGER  
CONFIG_STREAM_FLASH=y
CONFIG_FLASH_MAP=y

# Configure dependencies for CONFIG_MCUMGR_TRANSPORT_UART 
CONFIG_BASE64=y

# Step 1.1 - Enable SPI driver for Application
# Step 1.1 - Enable SPI driver for the application
CONFIG_GPIO=y
CONFIG_SPI=y
CONFIG_SPI_NOR=y
CONFIG_SPI_NOR_SFDP_DEVICETREE=n
CONFIG_SPI_NOR_SFDP_RUNTIME=y
CONFIG_SPI_NOR_FLASH_LAYOUT_PAGE_SIZE=4096
# QSPI drivers are enabled by defualt for some chips.
# Disable it explicitly to be sure QSPI is disabled.
CONFIG_NORDIC_QSPI_NOR=n 

# Development settings - Disable protection for easy programming
# WARNING: Remove these lines for production builds
CONFIG_NRF_APPROTECT_LOCK=n
CONFIG_NRF_APPROTECT_USER_HANDLING=n

CONFIG_NFCT_PINS_AS_GPIOS=y
```

## src/main.c
```c
/*
 * Copyright (c) 2016 Intel Corporation
 *
 * SPDX-License-Identifier: Apache-2.0
 */

#include <stdio.h>
#include <zephyr/kernel.h>
#include <zephyr/drivers/gpio.h>

/* 1000 msec = 1 sec */

#define SLEEP_TIME_MS   1000

/* The devicetree node identifier for the "led0" alias. */
#define LED0_NODE DT_ALIAS(led0)

/* Define RGB LEDs using direct GPIO specification */
#define RGB_R_PIN     31
#define RGB_G_PIN     30
#define RGB_B_PIN     29
#define GPIO0_NODE    DT_NODELABEL(gpio0)

/*
 * A build error on this line means your board is unsupported.
 * See the sample documentation for information on how to fix this.
 */
static const struct gpio_dt_spec led = GPIO_DT_SPEC_GET(LED0_NODE, gpios);
static const struct gpio_dt_spec rgb_r = {
    .port = DEVICE_DT_GET(GPIO0_NODE),
    .pin = RGB_R_PIN,
    .dt_flags = GPIO_ACTIVE_LOW
};

static const struct gpio_dt_spec rgb_g = {
    .port = DEVICE_DT_GET(GPIO0_NODE),
    .pin = RGB_G_PIN,
    .dt_flags = GPIO_ACTIVE_LOW
};

static const struct gpio_dt_spec rgb_b = {
    .port = DEVICE_DT_GET(GPIO0_NODE),
    .pin = RGB_B_PIN,
    .dt_flags = GPIO_ACTIVE_LOW
};

int main(void)
{
	/* Initialize the LED GPIO pin */

	int ret;

	/*if (!device_is_ready(led.port)) {
		return -1;
	} */

	/* ret = gpio_pin_configure_dt(&led, GPIO_OUTPUT_ACTIVE);
	if (ret < 0) {
		return -1;
	} */

	/* Configure RGB LEDs */
	if (!device_is_ready(rgb_r.port)) {
		printk("LED ROJO no disponible\n");
		return -1;
	}

	ret = gpio_pin_configure_dt(&rgb_r, GPIO_OUTPUT_INACTIVE);
	if (ret < 0) {
		printk("LED ROJO no disponible\n");
		return -1;
	}

	ret = gpio_pin_configure_dt(&rgb_g, GPIO_OUTPUT_INACTIVE);
	if (ret < 0) {
		printk("LED VERDE no disponible\n");
		return -1;
	}

	ret = gpio_pin_configure_dt(&rgb_b, GPIO_OUTPUT_INACTIVE);
	if (ret < 0) {
		printk("LED AZUL no disponible\n");
		return -1;
	}

	printk("DFU External Test - Firmware cargado correctamente! v1.0\n");
	printk("Iniciando test simple de LEDs RGB...\n");

	// Secuencia de inicio - 3 parpadeos para confirmar boot
	for (int i = 0; i < 3; i++) {
		gpio_pin_set_dt(&rgb_r, 1);
		k_msleep(100);
		gpio_pin_set_dt(&rgb_r, 0);
		k_msleep(100);
	}

	int counter = 0;
	while (1) {
		// Patrón más simple y lento
		switch (counter % 3) {
			case 0:
				gpio_pin_set_dt(&rgb_r, 1); // Rojo ON
				gpio_pin_set_dt(&rgb_g, 0); // Verde OFF
				gpio_pin_set_dt(&rgb_b, 0); // Azul OFF
				printk("LED: ROJO\n");
				break;
			case 1:

				gpio_pin_set_dt(&rgb_r, 0);
				gpio_pin_set_dt(&rgb_g, 1); // Verde ON
				gpio_pin_set_dt(&rgb_b, 0);
				printk("LED: VERDE\n");
				break;
			case 2:
				/* Agrego esto*/
				gpio_pin_set_dt(&rgb_r, 0);
				gpio_pin_set_dt(&rgb_g, 0);
				gpio_pin_set_dt(&rgb_b, 1); // Azul ON
				printk("LED: AZUL\n");
				break;
		}
		counter++;
		k_msleep(2000); // 2 segundos entre cambios
	}
}
```
