## FLAHS_extern_f/build_1/mcuboot/Kconfig/Kconfig.shield
```kconfig
osource "C:/NordProjc/blinky_LEDS_UART/boards/shields/*/Kconfig.shield"
osource "C:/ncs/v2.9.0/nrf/boards/shields/*/Kconfig.shield"
```

## build/FLAHS_SPI/Kconfig/Kconfig.shield
```kconfig
osource "C:/NordProjc/l5_SPI_manul/boards/shields/*/Kconfig.shield"
osource "C:/NordProjc/Smart_Lamp_Nordic_V3.1/boards/shields/*/Kconfig.shield"
osource "C:/NordProjc/blinky/boards/shields/*/Kconfig.shield"
osource "C:/ncs/v2.9.0/nrf/boards/shields/*/Kconfig.shield"
```

## build/Kconfig/Kconfig.shield
```kconfig
osource "C:/NordProjc/l5_SPI_manul/boards/shields/*/Kconfig.shield"
osource "C:/ncs/v2.9.0/nrf/boards/shields/*/Kconfig.shield"
```

## build/mcuboot/Kconfig/Kconfig.shield.defconfig
```kconfig
osource "C:/NordProjc/l5_SPI_manul/boards/shields/*/Kconfig.defconfig"
osource "C:/NordProjc/Smart_Lamp_Nordic_V3.1/boards/shields/*/Kconfig.defconfig"
osource "C:/NordProjc/blinky/boards/shields/*/Kconfig.defconfig"
osource "C:/ncs/v2.9.0/nrf/boards/shields/*/Kconfig.defconfig"
```

## build/spi_DFU_External/Kconfig/Kconfig.shield.defconfig
```kconfig
osource "C:/NordProjc/l5_SPI_manul/boards/shields/*/Kconfig.defconfig"
osource "C:/ncs/v2.9.0/nrf/boards/shields/*/Kconfig.defconfig"
```
